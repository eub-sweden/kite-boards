## boards/arm/kite_nrf52840/Kconfig.board
```kconfig
# Kite nRF52840 board configuration

# SPDX-License-Identifier: Apache-2.0

config BOARD_KITE_NRF52840
	bool "Kite nRF52840"
	depends on SOC_NRF52840_QIAA
```

## boards/arm/kite_nrf52840/kite_nrf52840_defconfig
```kconfig
# SPDX-License-Identifier: Apache-2.0

CONFIG_SOC_SERIES_NRF52X=y
CONFIG_SOC_NRF52840_QIAA=y
CONFIG_BOARD_KITE_NRF52840=y

# Enable MPU
CONFIG_ARM_MPU=y

# Enable hardware stack protection
CONFIG_HW_STACK_PROTECTION=y

# Enable GPIO
CONFIG_GPIO=y

# Enable UART driver
CONFIG_SERIAL=y

# Enable console
CONFIG_CONSOLE=y
CONFIG_UART_CONSOLE=y

# Additional board options
CONFIG_PINCTRL=y
```

## boards/arm/kite_nrf9151/Kconfig.board
```kconfig
# Kite-nRF9151

# Copyright (c) 2023 Elektronikutvecklingsbyrån EUB AB
# SPDX-License-Identifier: Apache-2.0

if SOC_NRF9151_LACA

config BOARD_KITE_NRF9151
	bool "Kite-nRF9151"

config BOARD_KITE_NRF9151_NS
	bool "Kite-nRF9151 non-secure"

endif # SOC_NRF9151_LACA
```

## boards/arm/kite_nrf9160/Kconfig.board
```kconfig
# Kite-nRF9160

# Copyright (c) 2023 Elektronikutvecklingsbyrån EUB AB
# SPDX-License-Identifier: Apache-2.0

if SOC_NRF9160_SICA

config BOARD_KITE_NRF9160
	bool "Kite-nRF9160"

config BOARD_KITE_NRF9160_NS
	bool "Kite-nRF9160 non-secure"

endif # SOC_NRF9160_SICA
```

## boards/arm/minimal_nrf9151/Kconfig.board
```kconfig
# Minimal-nRF9151

# Copyright (c) 2023 Elektronikutvecklingsbyrån EUB AB
# SPDX-License-Identifier: Apache-2.0

if SOC_NRF9151_LACA

config BOARD_MINIMAL_NRF9151
	bool "Minimal-nRF9151"

config BOARD_MINIMAL_NRF9151_NS
	bool "Minimal-nRF9151 non-secure"

endif # SOC_NRF9151_LACA
```

## boards/arm/vidante_snuro/Kconfig.board
```kconfig
# Vidante Snuro board configuration

# SPDX-License-Identifier: Apache-2.0

config BOARD_VIDANTE_SNURO
	bool "Vidante Snuro"
	depends on SOC_NRF52840_QIAA
```

## boards/arm/vidante_snuro/Kconfig.defconfig
```kconfig
# Vidante Snuro board configuration

# SPDX-License-Identifier: Apache-2.0

if BOARD_VIDANTE_SNURO

config BOARD
	default "vidante_snuro"

config BT_CTLR
	default BT

endif # BOARD_VIDANTE_SNURO
```

## boards/eub/kite_nrf52840/Kconfig
```kconfig
# Kite nRF52840 board configuration

# SPDX-License-Identifier: Apache-2.0

config BOARD_ENABLE_DCDC
	bool "Enable DCDC mode"
	select SOC_DCDC_NRF52X
	default y
	depends on BOARD_KITE_NRF52840
```

## boards/eub/kite_nrf52840/Kconfig.defconfig
```kconfig
# Kite nRF52840 board configuration

# SPDX-License-Identifier: Apache-2.0

if BOARD_KITE_NRF52840_NRF52840

config BOARD
	default "kite_nrf52840"

config BT_CTLR
	default BT

endif # BOARD_KITE_NRF52840_NRF52840
```

## boards/eub/kite_nrf52840/Kconfig.kite_nrf52840
```kconfig
# Kite nRF52840 board configuration

# SPDX-License-Identifier: Apache-2.0

config BOARD_KITE_NRF52840
	select SOC_NRF52840_QIAA
```

## boards/eub/kite_nrf52840/board.yml
```yaml
board:
  name: kite_nrf52840
  full_name: Kite-nRF52840
  vendor: eub
  socs:
  - name: nrf52840
```

## boards/eub/kite_nrf9151/Kconfig.defconfig
```kconfig
# Kite-nRF9151 board configuration

# Copyright (c) 2023 Elektronikutvecklingsbyrån EUB AB
# SPDX-License-Identifier: Apache-2.0

config HW_STACK_PROTECTION
	default ARCH_HAS_STACK_PROTECTION

if BOARD_KITE_NRF9151_NRF9151 || BOARD_KITE_NRF9151_NRF9151_NS

config BOARD_KITE_NRF9151
	select USE_DT_CODE_PARTITION if BOARD_KITE_NRF9151_NRF9151_NS

endif # BOARD_KITE_NRF9151_NRF9151 || BOARD_KITE_NRF9151_NRF9151_NS
```

## boards/eub/kite_nrf9151/Kconfig.kite_nrf9151
```kconfig
# Kite-nRF9151

# Copyright (c) 2023 Elektronikutvecklingsbyrån EUB AB
# SPDX-License-Identifier: Apache-2.0

config BOARD_KITE_NRF9151
        select SOC_NRF9151_LACA
```

## boards/eub/kite_nrf9151/board.yml
```yaml
board:
  name: kite_nrf9151
  full_name: Kite-nRF915
  vendor: eub
  socs:
  - name: nrf9151
    variants:
    - name: 'ns'
```

## boards/eub/kite_nrf9160/Kconfig.defconfig
```kconfig
# Kite-nRF9160 board configuration

# Copyright (c) 2023 Elektronikutvecklingsbyrån EUB AB
# SPDX-License-Identifier: Apache-2.0

config HW_STACK_PROTECTION
	default ARCH_HAS_STACK_PROTECTION

if BOARD_KITE_NRF9160_NRF9160 || BOARD_KITE_NRF9160_NRF9160_NS

config BOARD_KITE_NRF9160
	select USE_DT_CODE_PARTITION if BOARD_KITE_NRF9160_NRF9160_NS

endif # BOARD_KITE_NRF9160_NRF9160 || BOARD_KITE_NRF9160_NRF9160_NS
```

## boards/eub/kite_nrf9160/Kconfig.kite_nrf9160
```kconfig
# Kite-nRF9160

# Copyright (c) 2023 Elektronikutvecklingsbyrån EUB AB
# SPDX-License-Identifier: Apache-2.0

config BOARD_KITE_NRF9160
        select SOC_NRF9160_SICA
```

## boards/eub/kite_nrf9160/board.yml
```yaml
board:
  name: kite_nrf9160
  full_name: Kite-nRF9160-Non-Secure
  vendor: nordic
  socs:
  - name: nrf9160
    variants:
    - name: 'ns'
```
