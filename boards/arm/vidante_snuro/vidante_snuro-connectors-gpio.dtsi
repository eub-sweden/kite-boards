/*
 * NOTE: Autogenerated file using gen-connectors-dtsi.py
 *
 * SPDX-License-Identifier: Apache-2.0
 */

/ {
	pmod1: pmod1-gpio {
		compatible = "digilent,pmod-gpio-single";
		#gpio-cells = <2>;
		gpio-map-mask = <0xffffffff 0xffffffc0>;
		gpio-map-pass-thru = <0 0x3f>;
		gpio-map = <0 0 &gpio0 2 0>,	/* IO1 */
			   <1 0 &gpio0 3 0>,	/* IO2 */
			   <2 0 &gpio0 4 0>,	/* IO3 */
			   <3 0 &gpio1 5 0>;	/* IO4 */
	};

};